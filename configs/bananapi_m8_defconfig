## configs/bananapi_m8_defconfig
```kconfig
CONFIG_SUNXI_TEXT_SIZE=0x180000
CONFIG_RESERVE_FDT_SIZE=0x80000
CONFIG_ARM=y
CONFIG_ARM_SMCCC=y
CONFIG_SYS_TEXT_BASE=0x4A000000
CONFIG_SUNXI_SECURE_BOOT=y
CONFIG_SUNXI_WDT_V2=y
CONFIG_MACH_SUN60IW2=y
CONFIG_R_I2C0_ENABLE=y
CONFIG_USB0_VBUS_PIN="PL2"
CONFIG_USB1_VBUS_PIN="PH12"
CONFIG_DEFAULT_DEVICE_TREE="sun60i-a733-bananapi-m8"
# CONFIG_SYS_MALLOC_F is not set
# CONFIG_SYS_MALLOC_CLEAR_ON_INIT is not set
CONFIG_PHYS_64BIT=y
CONFIG_ANDROID_BOOT_IMAGE=y
CONFIG_SUNXI_SERIAL=y
CONFIG_ANDROID_AB=y
CONFIG_SUNXI_MAC=y
CONFIG_SUNXI_USER_KEY=y
CONFIG_SUNXI_DRM_SUPPORT=y
CONFIG_SUNXI_ANDROID_BOOT=y
CONFIG_SUNXI_VERIFY_BOOT_INFO_INSTALL=y
CONFIG_SUNXI_NECESSARY_REPLACE_FDT=y
CONFIG_SUNXI_HOMLET=y
CONFIG_RECOVERY_KEY=y
CONFIG_SUNXI_HDCP_IN_SECURESTORAGE=y
CONFIG_SUNXI_RKP=y
CONFIG_SUNXI_RNG_SEED=y
CONFIG_CMD_FASTBOOT=y
CONFIG_CMD_EXT2=y
CONFIG_CMD_EXT4=y
CONFIG_CMD_FS_GENERIC=y
CONFIG_CMD_PART=y
CONFIG_CMD_USB=y
CONFIG_CMD_SUNXI_TIMER=y
CONFIG_CMD_SUNXI_SPRITE=y
CONFIG_CMD_SUNXI_BURN=y
CONFIG_CMD_SUNXI_MEMTEST=y
CONFIG_LAST_PARTITION_NAME="UDISK"
CONFIG_DM=y
CONFIG_SUNXI_GPADC=y
CONFIG_CLK_SUNXI=y
CONFIG_SUNXI_DMA=y
CONFIG_AW_GPIO_V3=y
CONFIG_SYS_I2C_SUNXI=y
CONFIG_SYS_SUNXI_R_I2C0_SLAVE=0x34
CONFIG_AXP8191_SUNXI_I2C_SLAVE=0x36
CONFIG_MMC=y
CONFIG_UFS=y
CONFIG_SUNXI_POWER=y
CONFIG_SUNXI_PMU=y
CONFIG_SUNXI_BMU=y
CONFIG_AXP8191_POWER=y
CONFIG_SUNXI_UBOOT_POWER_OFF=y
CONFIG_USB=y
CONFIG_USB_EHCI_HCD=y
CONFIG_USB_STORAGE=y
CONFIG_AW_DRM=y
CONFIG_AW_DRM_LVDS=y
CONFIG_AW_DRM_DSI=y
CONFIG_AW_DRM_EDP=y
CONFIG_AW_DRM_TRILINEAR_EDP14=y
# CONFIG_AW_DRM_EINK200 is not set
CONFIG_AW_DRM_PANEL=y
CONFIG_PANEL_DSI_GENERAL=y
CONFIG_PANEL_LVDS_GENERAL=y
CONFIG_PANEL_EDP_GENERAL=y
CONFIG_AW_DRM_PHY=y
CONFIG_SUNXI_SDMMC=y
CONFIG_MMC_LOGICAL_OFFSET=0
CONFIG_SUNXI_BOOT0_SDMMC_BACKUP_START_ADDR=2064
CONFIG_SUNXI_UFS=y
CONFIG_SUNXI_USB=y
CONFIG_SUNXI_EFEX=y
CONFIG_SUNXI_BURN=y
CONFIG_SUNXI_CE_30=y
CONFIG_SUNXI_ARISC_EXIST=y
CONFIG_ARISC_DEASSERT_BEFORE_KERNEL=y
CONFIG_DISTRO_DEFAULTS=y
# CONFIG_SUNXI_ANDROID_OVERLAY is not set
CONFIG_CMD_BOOTI=y
CONFIG_OF_LIBFDT_OVERLAY=y
CONFIG_SUNXI_SPRITE=y
CONFIG_SUNXI_SPRITE_CARTOON=y
CONFIG_SUNXI_BOOT_PARAM=y
CONFIG_SUNXI_TURNNING_DRAM=y
CONFIG_HUSH_PARSER=y
# CONFIG_SUNXI_UPDATE_GPT is not set
# CONFIG_ENV_IS_IN_SUNXI_FLASH is not set
CONFIG_ENV_IS_NOWHERE=y
CONFIG_ENV_SIZE=0x20000
CONFIG_BOOTDELAY=3
CONFIG_USE_DEFAULT_ENV_FILE=y
CONFIG_DEFAULT_ENV_FILE="board/sunxi/bananapi_m8.env"
```
